#include "panel/dsi-panel-ft8613-ebbg-5p7-720p-video.dtsi"
#include "panel/dsi-panel-ft8006m-boe-5p7-720p-video.dtsi"
#include "panel/dsi-panel-ft8613-csot-5p7-720p-video.dtsi"

&dsi_ft8613_ebbg_5p7_720p_video {
        qcom,panel-supply-entries = <&dsi_panel_pwr_supply>;
        qcom,qpnp-ibb-init-lcd-voltage = <5800000>;
        qcom,qpnp-lab-init-lcd-voltage = <5800000>;
};
&dsi_ft8006m_boe_5p7_720p_video {
        qcom,panel-supply-entries = <&dsi_panel_pwr_supply>;
        qcom,qpnp-ibb-init-lcd-voltage = <6000000>;
        qcom,qpnp-lab-init-lcd-voltage = <6000000>;
};
&dsi_ft8613_csot_5p7_720p_video {
        qcom,panel-supply-entries = <&dsi_panel_pwr_supply>;
        qcom,qpnp-ibb-init-lcd-voltage = <5800000>;
        qcom,qpnp-lab-init-lcd-voltage = <5800000>;
};