/ {
	qrd_batterydata: qcom,battery-data {
		qcom,batt-id-range-pct = <15>;
		#include "batterydata/batterydata-Scud-4v4-3300mah.dtsi"
		#include "batterydata/batterydata-Sunwoda-4v4-3300mah.dtsi"
		#include "batterydata/batterydata-D1_Default-4v4-3300mah.dtsi"
	};
};